## package/orocos-log4cpp/Config.in
```kconfig
config BR2_PACKAGE_OROCOS_LOG4CPP
	bool "orocos-log4cpp"
	help
	The Orocos port of the log4cpp logging library to enable real time logging inside Orocos. 

	  http://www.orocos.org
```

## package/orocos-ocl/Config.in
```kconfig
config BR2_PACKAGE_OROCOS_OCL
	bool "orocos-ocl"
	select BR2_PACKAGE_OMNIORB
	select BR2_PACKAGE_OROCOS_RTT
	select BR2_PACKAGE_OROCOS_LOG4CPP
	select BR2_PACKAGE_READLINE
	help
	Orocos Component Library
	  The Orocos 2 toolchain is your primary tool to create real-time robotics applications
	using modular, run-time configurable software components. OCL is the Orocos Component
	Library, the necessary components to start an application and interact with it at 
	run-time.

	  http://www.orocos.org

menu "Orocos Component Library configuration"
	depends on BR2_PACKAGE_OROCOS_OCL

config BR2_PACKAGE_OROCOS_OCL_DEPLOYMENT
	bool "Dynamic Deployment"
	default y
	help
	Orocos deployer
	  A Component for deploying (configuring) other components in an
	application. It allows to create connections between components,
	load the properties and scripts for components and setup
	component activities.

config BR2_PACKAGE_OROCOS_OCL_HELLOWORLD
	bool "Hello World Component"
	default n
	help
	Hello world component
	  Compile a simple component to begin with Orocos. 
	Unless you are doing a sandbox, say no.

config BR2_PACKAGE_OROCOS_OCL_LOGGING
	bool "Logging system"
	default y
	help
	  Allow Real Time Logging service. It uses orocos-log4cpp.

config BR2_PACKAGE_OROCOS_OCL_LUA
	bool "Lua addon"
	default y
	help
	  Integrate Lua for scripting/deployment.

config BR2_PACKAGE_OROCOS_OCL_REPORTING
	bool "Reporting Component"
	default n
	help
	  The Reporter is a component that let you tracing dataflows between components. It is a debugging tool.

config BR2_PACKAGE_OROCOS_OCL_TASKBROWSER
	bool "Taskbrowser"
	default y
	help
	  The Taskbrowser is a command line tool that allows you to deploy, manage, monitor, debug your application at run time.

config BR2_PACKAGE_OROCOS_OCL_TIMER
	bool "Timers"
	default y
	help
	  Include a timer Component that helps generating events triggered on time.

config BR2_PACKAGE_OROCOS_OCL_RTALLOC
	bool "RT Alloc"
	select BR2_PACKAGE_READLINE
	default n
	help
	  Build with rt-malloc support.

endmenu
```

## package/orocos-rtt/Config.in
```kconfig
config BR2_PACKAGE_OROCOS_RTT
	bool "orocos-rtt"
	select BR2_PACKAGE_BOOST
	select BR2_PACKAGE_OMNIORB
	select BR2_PACKAGE_BOOST_CONFIG_THREADING
	select BR2_PACKAGE_BOOST_FILESYSTEM
	select BR2_PACKAGE_BOOST_PROGRAM_OPTIONS
	select BR2_PACKAGE_BOOST_SERIALIZATION
	select BR2_PACKAGE_BOOST_SYSTEM
	help
	Real Time toolkit
	  The Orocos 2 toolchain is your primary tool to create real-time robotics applications
	using modular, run-time configurable software components. RTT is the Real-Time Toolkit,
	a component framework that allows us to write real-time components in C++.

	  http://www.orocos.org

menu "Real Time Toolkit configuration"
	depends on BR2_PACKAGE_OROCOS_RTT

config BR2_PACKAGE_OROCOS_RTT_OS_EMBEDDED_SCRIPTING
	bool "Embedded Scripting"
	default y
	help
	  TODO.

#config BR2_PACKAGE_OROCOS_RTT_ENABLE_CORBA
#	bool "Corba integration"
#	default n
#	help
#	  Enable Corba for network Port connectivity.
# Requires to choose between : TAO end Omniorb...

config BR2_PACKAGE_OROCOS_RTT_ENABLE_MQ
	bool "Message queue data flow."
	default y
	help
	Message Queue Transport.
	  This transport allows to do inter-process communication between Orocos processes
	on the same node. It uses the POSIX messages queues where available. This includes
	GNU/Linux systems and Xenomai.
	MQueue also requires the boost::serialization	library.

config BR2_PACKAGE_OROCOS_RTT_ACT_DEFAULT_ACTIVITY
	bool "Default Activity in Components"
	default n
	help
	Default Activity.
	  Give a default activity to components. Activate this if you are not abble 
	to define activities to component at deployment time. In general you will say
	no as you will precise if the activity is periodic or not.

config BR2_PACKAGE_OROCOS_RTT_PLUGINS_ENABLE
	bool "Plugins support"
	default y
	help
	  Activate RTT plugins support.

config BR2_PACKAGE_OROCOS_RTT_PLUGINS_ENABLE_TYPEKIT
	bool "Typekit plugins"
	default y
	help
	  Enable typekits.

endmenu
```
